## apps/Config.in
```kconfig
menu "Applications"

source apps/phone/Config.in
source apps/media/Config.in
source apps/pim/Config.in

endmenu
```

## apps/media/Config.in
```kconfig
menu 'Media Applications'

config CONFIG_MEDIA
       bool "Build Media Applications"
       default y
       depends CONFIG_FLNX
       help
        Say 'yes' here to build the FLTK Phone and other
        applications


config MEDIA_MP3_PLAYER
	bool "Build MP3 player"
	default n
	depends CONFIG_MEDIA
	help
	  Say Y here if you want to build Mp3 player

	  Most people should answer Y.

endmenu
```

## apps/phone/Config.in
```kconfig
menu "Phone Applications"

config CONFIG_PHONEAPPS
       bool "Build Phone Applications"
       default y
       help
	Say 'yes' here to build the FLTK Phone and other
	applications

config CONFIG_DIALER
       bool "Dialer"
       default y
        depends CONFIG_PHONEAPPS
       help
	Say 'yes' here to build the Dialer application,
	used to dial a phone number

config CONFIG_INCOMING_CALL
       bool "Incoming Call UI"
       default y
        depends CONFIG_PHONEAPPS
       help
	Say 'yes' here to build the Incoming Call application,
	which handles incoming calls

config CONFIG_CALL_LOGS
       bool "Call logs"
       default y
        depends CONFIG_PHONEAPPS
       help
	Say 'yes' here to build the Call logs application,
	handles dialed, answered and missed calls lists

config CONFIG_MESSAGES
       bool "Messages"
       default y
        depends CONFIG_PHONEAPPS
       help
	Say 'yes' here to build the Messages application,
	starter for all the SMS and MMS related apps

config CONFIG_MENUPUSK
       bool "Menu pusk on left softkey"
       default y
       depends CONFIG_PHONEAPPS
       help
	Say 'yes' here to build menu pusk

config CONFIG_TEST
       bool "Test program to play with"
       default y
       depends CONFIG_PHONEAPPS
       help
	Say 'yes' here to build the sample program

endmenu
```

## apps/pim/Config.in
```kconfig
menu 'PIM Applications'

config CONFIG_PIM
	bool "Build PIM application"
	default n
	help
	  Say Y here if you want to build PIM apps

	  Most people should answer Y.

config CONFIG_PIM_CONTACTS
	bool "Build contacts application"
	default n
	depends CONFIG_PIM
	help
	  Say Y here if you want to build Contact

	  Most people should answer Y.

endmenu
```

## libs/Config.in
```kconfig
menu 'Libraries'

config CONFIG_FLGUI
       bool "FLGUI - fltk widgets for flphone"
       default y
       help
	Say yes here to build FLGUI

config CONFIG_FLNX
       bool "FLNX - FLTK for Nano-X"
       default y
       help
	Say yes here to build FLNX for Microwindows

config CONFIG_FLNX_DEBUG
       bool "FLNX Debug"
       default n
       depends CONFIG_FLNX
       help
	Say yes here to build FLNX for Microwindows

config CONFIG_LIBFLPHONE
       bool "libflphone - common lib for flphone"
       default y
       help
	Say yes here to build libflphone

config CONFIG_LIBTHEME
       bool "libtheme - common lib for theme handling"
       default y
       help
	Say yes here to build libtheme

config CONFIG_LIBTPL
       bool "libtpl - Fast, easy serialization in C"
       default y
       help
	Say yes here to build libtpl
	
	http://tpl.sourceforge.net

config CONFIG_LIBPIM
       bool "libpim - Personal Information Management library"
       default y
       help
	Say yes here to build libpim

config CONFIG_FFMPEG
       bool "ffmpeg - libavcodec and libavformat"
       default n
       help
	Say yes here to build ffmpeg

endmenu
```

## scripts/platforms/Config.in
```kconfig
menu "Platform Configuration"

choice
	prompt "Build Platform"
	default "Desktop"
	help
	  Select the desired build platform.  Among other things
	  this will install default scripts and other information.

config CONFIG_PLATFORM_SX1
        bool "Siemens SX1"

config CONFIG_PLATFORM_X86DEMO
       bool" Desktop"

endchoice

config CONFIG_CPU_ARM
       bool
       depends CONFIG_PLATFORM_SX1
       default y

config CONFIG_CPU_INTEL
       bool
       depends CONFIG_PLATFORM_X86DEMO 
       default y

endmenu
```

## scripts/sysdep/Config.in
```kconfig
#
# For a description of the syntax of this configuration file,
# see scripts/kbuild/config-language.txt.
#

mainmenu "Phone Configuration"

menu "Flphone Settings"

choice
	prompt "Graphical Engine"
	default "Nano-X"
	help
	  Pixil can be build for either Nano-X (Microwindows) or X11.
	  Using Nano-X will result in significantly smaller binaries.

config CONFIG_X11
       bool "X11"

config CONFIG_NANOX
       bool "Nano-X"

endchoice


menu "Interface layout"

config CONFIG_SCREEN_WIDTH
        int "Screen X size (width)"
        default 176
        help
	    Screen X size

config CONFIG_SCREEN_HEIGHT
	int "Screen Y size (height)"
        default 220
        help
	    Screen Y size


endmenu

config CONFIG_PM
       bool "Enable power management support"
       default y
       help
       Enable support for power managment

config CONFIG_SYNC
	bool "Enable Sync support"
	default y
	depends CONFIG_COLOSSEUM
	help
	Build all the nessesary components for the sync engine

source scripts/platforms/Config.in

endmenu


menu 'Build Options'

config CROSS_COMPILE
	bool "Do you want to build with a cross compiler?"
	default n
	help
	  Enable this option to build with a cross compiler.

config CROSS_COMPILER_PREFIX
	string "Cross compiler prefix"
	default "arm-linux-"
	depends CROSS_COMPILE
	help
	  If you want to build with a cross compiler, then you 
	  will need to set this to the cross-compiler prefix.  For example,
	  if my cross-compiler is /usr/local/arm/bin/arm-linux-gcc, 
	  then I would enter /usr/local/arm/bin/arm-linux- here,
	  which will ensure the correct compiler is used.

config MW_PREFIX
        string "Microwindows prefix"
	default "/usr/local/microwin/src/"
	help
	  If you choose to use Microwindows, you need to specify where
	  the Microwindows libraries are located.  Remember to specify
	  the right tree for the compiler you are building for.

#config INSTALL_PREFIX
#       string "Install prefix"
#       default "/usr/local/flphone"
#       help
#         Indicate where flphone should be installed when it is built

config CONFIG_SAMPLES
	bool "Install sample data?"
	default y
	help
	  Install sample data for the applications

config CONFIG_GCC_HIDDEN_VISIBILITY
	bool "Build with hidden visibility"
	default n
	help
	  Say Y here if you wish to compile with hidden visibility enabled.

config CONFIG_DEBUG
	bool "Build with debugging symbols"
	default n
	help
	  Say Y here if you wish to compile with debugging symbols.
	  This increases the size of the binary 
	  considerably and should only be used when doing development.

config WERROR
	bool "Abort compilation on any warning"
	default n
	help
	  Selecting this will add -Werror to gcc command line.

	  Most people should answer N.

endmenu

source apps/Config.in
source libs/Config.in
source system/Config.in
```

## system/Config.in
```kconfig
menu 'System applications'

config CONFIG_NANOWM
	bool "Build Nanowm"
	default n
	help
	  Say Y here if you want to build window manager

	  Most people should answer Y.

config CONFIG_TBUS
        bool "Build T-BUS ipc server and lib"
        default n
        help
          Say Y here if you want to use TBUS IPC

          Most people should answer Y.

config CONFIG_THAL
        bool "Build T-HAL hardware abstraction on T-BUS"
        default n
        depends CONFIG_TBUS
        help
          Say Y here if you want to use T-HAL

          Most people should answer Y.

config CONFIG_GSMMUX
        bool "Build gsmMux multiplexer daemon"
        default y
        help
          Say Y here if you want to use GSM mux

	  http://developer.berlios.de/projects/gsmmux/
          Most people should answer Y.

config CONFIG_GSMD2
       bool "gsmd2 - OpenMoko`s gsmd with T-BUS interface"
       default y
       help
	Say yes here to build gsmd

source "system/daemons/Config.in"

endmenu
```

## system/daemons/Config.in
```kconfig
menu "System daemons"

config CONFIG_DAEMONS
       bool "Build system daemons"
       default y
       help
       Say yes here to build the daemons

config CONFIG_NSAVER
       bool "Screensaver (nsaver)"
       depends CONFIG_DAEMONS
       default y


config CONFIG_ALARMD
       bool "Alarms daemon"
       depends CONFIG_DAEMONS
       default y

config CONFIG_INDICATORD
       bool "Indicators daemon"
       depends CONFIG_DAEMONS
       default y

endmenu
```
